## boards/esp32c6_devkitc_hpcore.conf
```kconfig
# Initial ESP32-C6 DevKitC port: Wi-Fi + HTTP web UI + UART console only.

# Disable features that require STM32-specific flash code or extra hardware
# not wired up on this devkit yet.
CONFIG_PERSISTENT_STORAGE=n
CONFIG_RTC=n
CONFIG_APP_NTP=n
CONFIG_APP_SENSORS=n
# Host serial bridge: UART1 (GPIO4 TX / GPIO5 RX) captured into a ring buffer,
# exposed via TCP port 22 (CONSOLE_BRIDGE) and the web UI terminal.
# The console logger uses UART async API which requires GDMA on the C6.
CONFIG_APP_CONSOLE_LOGGER=y
CONFIG_CONSOLE_BRIDGE=y
CONFIG_APP_WEB_TERMINAL_HOST_SERIAL=y
CONFIG_DMA=y

# Host power button on GPIO6 — `power on/off` does a short press,
# `power force-off` does a long press.
CONFIG_APP_HOST_POWER_PULSE=y

# Plain HTTP only for first bring-up — mbedtls/TLS adds heap pressure we
# can revisit once the basics work.
CONFIG_APP_HTTPS=n

# Wi-Fi station + WPA supplicant. Credentials are normally set at
# runtime via the `wifi connect <ssid> <password>` shell command and
# persisted in NVS, so the build does not need an SSID baked in. To
# bake one in for first-boot bring-up without console access, pass
#   -DCONFIG_WIFI_CREDENTIALS=y
#   -DCONFIG_WIFI_CREDENTIALS_STATIC=y
#   -DCONFIG_WIFI_CREDENTIALS_STATIC_SSID='"..."'
#   -DCONFIG_WIFI_CREDENTIALS_STATIC_PASSWORD='"..."'
# on the cmake line.
CONFIG_WIFI=y
CONFIG_NET_L2_WIFI_MGMT=y

# Wi-Fi/network stack sizing. Trimmed from the upstream samples/net/wifi/shell
# defaults to free SRAM for the heap (Redfish JSON allocations were failing
# under concurrent requests).
CONFIG_MAIN_STACK_SIZE=4096
CONFIG_SHELL_STACK_SIZE=4096
CONFIG_NET_TX_STACK_SIZE=2048
CONFIG_NET_RX_STACK_SIZE=2048
CONFIG_NET_MGMT_EVENT_QUEUE_TIMEOUT=5000
CONFIG_NET_MGMT_EVENT_QUEUE_SIZE=16

# Smaller TCP recv window + fewer net buffers / contexts. Redfish payloads
# are small so the 20K default window was wasted on Wi-Fi.
CONFIG_NET_TCP_MAX_RECV_WINDOW_SIZE=4096
CONFIG_NET_BUF_RX_COUNT=24
CONFIG_NET_BUF_TX_COUNT=24
CONFIG_NET_PKT_RX_COUNT=8
CONFIG_NET_PKT_TX_COUNT=8
CONFIG_NET_MAX_CONTEXTS=6
# MAX_CLIENTS must be >= the concurrent field in HTTP_SERVICE_DEFINE
# (src/http.c declares concurrent = 3).
CONFIG_HTTP_SERVER_MAX_CLIENTS=3

# Heap for Wi-Fi / TCP buffers — bumped to absorb the SRAM freed above so
# Redfish JSON allocations have more headroom.
CONFIG_HEAP_MEM_POOL_SIZE=81920

# Provides random for WPA supplicant
CONFIG_TEST_RANDOM_GENERATOR=y
```

## boards/xiao_esp32c6_hpcore.conf
```kconfig
# Initial Seeed XIAO ESP32-C6 port: Wi-Fi + HTTP web UI + USB-CDC console.

# Disable features that require extra hardware not wired up on this devkit yet.
CONFIG_RTC=n
CONFIG_APP_NTP=n
CONFIG_APP_SENSORS=n
# Host serial bridge: UART1 on GPIO0 TX / GPIO21 RX (the XIAO's D0/D3)
# captured into a ring buffer, exposed via TCP port 22 (CONSOLE_BRIDGE)
# and the web UI terminal. The BMC's own console runs over the SoC's
# built-in USB Serial/JTAG (the XIAO's USB-C connector). The console
# logger uses UART async API which requires GDMA on the C6.
CONFIG_APP_CONSOLE_LOGGER=y
CONFIG_CONSOLE_BRIDGE=y
CONFIG_APP_WEB_TERMINAL_HOST_SERIAL=y
CONFIG_DMA=y

# Host power button on GPIO1 (D1) — `power on/off` does a short press,
# `power force-off` does a long press.
CONFIG_APP_HOST_POWER_PULSE=y

# Plain HTTP only for first bring-up — mbedtls/TLS adds heap pressure we
# can revisit once the basics work.
CONFIG_APP_HTTPS=n

# Wi-Fi station + WPA supplicant + compile-time credentials
CONFIG_WIFI=y
CONFIG_NET_L2_WIFI_MGMT=y
CONFIG_WIFI_CREDENTIALS=y
CONFIG_WIFI_CREDENTIALS_STATIC=y
# Provide -DCONFIG_WIFI_CREDENTIALS_STATIC_SSID='"..."'
# and  -DCONFIG_WIFI_CREDENTIALS_STATIC_PASSWORD='"..."' on the cmake line.

# Wi-Fi/network stack sizing. Trimmed from the upstream samples/net/wifi/shell
# defaults to free SRAM for the heap (Redfish JSON allocations were failing
# under concurrent requests).
CONFIG_MAIN_STACK_SIZE=4096
CONFIG_SHELL_STACK_SIZE=4096
CONFIG_NET_TX_STACK_SIZE=2048
CONFIG_NET_RX_STACK_SIZE=2048
CONFIG_NET_MGMT_EVENT_QUEUE_TIMEOUT=5000
CONFIG_NET_MGMT_EVENT_QUEUE_SIZE=16

# Smaller TCP recv window + fewer net buffers / contexts. Redfish payloads
# are small so the 20K default window was wasted on Wi-Fi.
CONFIG_NET_TCP_MAX_RECV_WINDOW_SIZE=4096
CONFIG_NET_BUF_RX_COUNT=24
CONFIG_NET_BUF_TX_COUNT=24
CONFIG_NET_PKT_RX_COUNT=8
CONFIG_NET_PKT_TX_COUNT=8
CONFIG_NET_MAX_CONTEXTS=6
CONFIG_HTTP_SERVER_MAX_CLIENTS=3

# Heap for Wi-Fi / TCP buffers — bumped to absorb the SRAM freed above so
# Redfish JSON allocations have more headroom.
CONFIG_HEAP_MEM_POOL_SIZE=81920

# Provides random for WPA supplicant
CONFIG_TEST_RANDOM_GENERATOR=y
```
